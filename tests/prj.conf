## CMakeLists.txt
```
cmake_minimum_required(VERSION 3.20.0)

find_package(Zephyr REQUIRED HINTS $ENV{ZEPHYR_BASE})
project(bikeshare_firmware_tests)

target_include_directories(app PRIVATE ../app/include)

target_sources(app PRIVATE
	src/main.c
	../app/src/button.c
	../app/src/channels.c
	../app/src/config.c
	../app/src/gnss.c
	../app/src/led.c
	../app/src/state.c
	../app/src/mqtt_client.c
	../app/src/telemetry.c
)
```

## prj.conf
```kconfig
CONFIG_ZTEST=y
CONFIG_ZBUS=y
CONFIG_JSON_LIBRARY=y

CONFIG_LOG=y
CONFIG_LOG_DEFAULT_LEVEL=3

CONFIG_SETTINGS=y
CONFIG_SETTINGS_RUNTIME=y
```

## src/main.c
```c
#include <errno.h>
#include <stdio.h>
#include <string.h>

#include <zephyr/ztest.h>

#include "channels.h"
#include "button.h"
#include "config.h"
#include "gnss.h"
#include "state.h"
#include "led.h"
#include "mqtt_client.h"
#include "telemetry.h"

ZTEST(bike_config, test_config_validation)
{
	struct bike_config cfg = { 0 };
	uint16_t port;

	zassert_false(bike_config_is_valid(&cfg));

	zassert_ok(bike_config_parse_mqtt_port("1883", &port));
	zassert_equal(port, 1883);
	zassert_equal(bike_config_parse_mqtt_port("0", &port), -EINVAL);
	zassert_equal(bike_config_parse_mqtt_port("65536", &port), -EINVAL);
	zassert_equal(bike_config_parse_mqtt_port("abc", &port), -EINVAL);

	strcpy(cfg.id, "BIKE_001");
	strcpy(cfg.device_token, "TOKEN");
	strcpy(cfg.mqtt_host, "broker.example.com");
	cfg.mqtt_port = 1883;
	strcpy(cfg.apn, "internet");

	zassert_true(bike_config_is_valid(&cfg));
}

ZTEST(bike_state, test_core_state_transitions)
{
	zassert_ok(bike_config_init());
	zassert_ok(bike_state_init());
	zassert_equal(bike_state_get(), BIKE_STATE_UNREGISTERED);

	zassert_ok(bike_config_set_id("BIKE_001"));
	zassert_ok(bike_config_set_device_token("TOKEN"));
	zassert_ok(bike_config_set_mqtt_host("broker.example.com"));
	zassert_ok(bike_config_set_mqtt_port(1883));
	zassert_ok(bike_config_set_apn("internet"));
	zassert_ok(bike_state_refresh_config());
	zassert_equal(bike_state_get(), BIKE_STATE_AVAILABLE);

	zassert_equal(bike_state_cancel("RENTAL_000"), -EACCES);
	zassert_ok(bike_state_authorize("RENTAL_001"));
	zassert_equal(bike_state_get(), BIKE_STATE_RESERVED);
	zassert_equal(strcmp(bike_state_get_rental_id(), "RENTAL_001"), 0);

	zassert_equal(bike_state_authorize("RENTAL_002"), -EACCES);
	zassert_equal(bike_state_cancel("RENTAL_002"), -EINVAL);
	zassert_equal(bike_state_get(), BIKE_STATE_RESERVED);

	zassert_ok(bike_state_button_press());
	zassert_equal(bike_state_get(), BIKE_STATE_IN_USE);
	zassert_ok(bike_state_cancel("RENTAL_001"));
	zassert_equal(bike_state_get(), BIKE_STATE_AVAILABLE);
	zassert_equal(bike_state_get_rental_id()[0], '\0');

	zassert_ok(bike_state_authorize("RENTAL_002"));
	zassert_ok(bike_state_button_press());
	zassert_equal(bike_state_get(), BIKE_STATE_IN_USE);
	zassert_ok(bike_state_button_press());
	zassert_equal(bike_state_get(), BIKE_STATE_AVAILABLE);
	zassert_equal(bike_state_get_rental_id()[0], '\0');
}

ZTEST(led_status, test_state_to_pattern_mapping)
{
	zassert_equal(led_status_pattern_for_state(BIKE_STATE_UNREGISTERED),
		      LED_STATUS_OFF);
	zassert_equal(led_status_pattern_for_state(BIKE_STATE_AVAILABLE),
		      LED_STATUS_BLINK_SLOW);
	zassert_equal(led_status_pattern_for_state(BIKE_STATE_RESERVED),
		      LED_STATUS_CHASE);
	zassert_equal(led_status_pattern_for_state(BIKE_STATE_IN_USE),
		      LED_STATUS_SOLID_ON);
	zassert_equal(led_status_pattern_for_state(BIKE_STATE_ERROR),
		      LED_STATUS_ERROR);
}

ZTEST(led_status, test_cached_pattern_is_applied_on_init)
{
	struct bike_state_msg msg = {
		.state = BIKE_STATE_AVAILABLE,
	};

	zassert_ok(zbus_chan_pub(&bike_state_chan, &msg, K_MSEC(100)));
	zassert_equal(led_status_get_pattern(), LED_STATUS_BLINK_SLOW);

	zassert_ok(led_status_init());
	zassert_equal(led_status_get_pattern(), LED_STATUS_BLINK_SLOW);
	zassert_true(led_status_is_on());
}

ZTEST(button_input, test_publish_press_drives_state_machine)
{
	button_input_reset_debounce();
	zassert_ok(bike_config_init());
	zassert_ok(bike_config_set_id("BIKE_001"));
	zassert_ok(bike_config_set_device_token("TOKEN"));
	zassert_ok(bike_config_set_mqtt_host("broker.example.com"));
	zassert_ok(bike_config_set_mqtt_port(1883));
	zassert_ok(bike_config_set_apn("internet"));
	zassert_ok(bike_state_init());
	zassert_equal(bike_state_get(), BIKE_STATE_AVAILABLE);

	zassert_ok(bike_state_authorize("RENTAL_003"));
	zassert_equal(bike_state_get(), BIKE_STATE_RESERVED);

	zassert_ok(button_input_publish_press(1234));
	zassert_equal(bike_state_get(), BIKE_STATE_IN_USE);

	zassert_ok(button_input_publish_press(5678));
	zassert_equal(bike_state_get(), BIKE_STATE_AVAILABLE);
}

ZTEST(button_input, test_debounce_rejects_duplicate_press)
{
	button_input_reset_debounce();
	zassert_ok(bike_config_init());
	zassert_ok(bike_config_set_id("BIKE_002"));
	zassert_ok(bike_config_set_device_token("TOKEN"));
	zassert_ok(bike_config_set_mqtt_host("broker.example.com"));
	zassert_ok(bike_config_set_mqtt_port(1883));
	zassert_ok(bike_config_set_apn("internet"));
	zassert_ok(bike_state_init());
	zassert_equal(bike_state_get(), BIKE_STATE_AVAILABLE);

	zassert_ok(bike_state_authorize("RENTAL_004"));
	zassert_equal(bike_state_get(), BIKE_STATE_RESERVED);

	zassert_ok(button_input_publish_press_debounced(1000));
	zassert_equal(bike_state_get(), BIKE_STATE_IN_USE);

	zassert_equal(button_input_publish_press_debounced(
			      1000 + BUTTON_INPUT_DEBOUNCE_MS - 1),
		      -EALREADY);
	zassert_equal(bike_state_get(), BIKE_STATE_IN_USE);

	zassert_ok(button_input_publish_press_debounced(
		1000 + BUTTON_INPUT_DEBOUNCE_MS));
	zassert_equal(bike_state_get(), BIKE_STATE_AVAILABLE);
}

ZTEST(mqtt_client, test_topic_construction)
{
	char topic[BIKE_MQTT_TOPIC_MAX_LEN];

	zassert_ok(bike_mqtt_build_command_topic("BIKE_001", topic,
						 sizeof(topic)));
	zassert_equal(strcmp(topic, "bikes/BIKE_001/commands"), 0);

	zassert_ok(bike_mqtt_build_telemetry_topic("BIKE_001", topic,
						   sizeof(topic)));
	zassert_equal(strcmp(topic, "bikes/BIKE_001/telemetry"), 0);

	zassert_ok(bike_mqtt_build_event_topic("BIKE_001", topic,
					       sizeof(topic)));
	zassert_equal(strcmp(topic, "bikes/BIKE_001/events"), 0);

	zassert_equal(bike_mqtt_build_command_topic("", topic, sizeof(topic)),
		      -EINVAL);
	zassert_equal(bike_mqtt_build_telemetry_topic("BIKE_001", topic, 8),
		      -ENAMETOOLONG);
}

ZTEST(mqtt_client, test_command_parsing)
{
	struct bike_backend_command_msg msg;
	char authorize[] = "{\"protocolVersion\":1,\"type\":\"rent_authorize\","
			   "\"rental_id\":\"R1\"}";
	char cancel[] = "{\"protocolVersion\":1,\"type\":\"rent_cancel\","
			"\"rental_id\":\"R2\"}";
	char unknown[] = "{\"protocolVersion\":1,\"type\":\"lock\","
			 "\"rental_id\":\"R3\"}";
	char missing_version[] = "{\"type\":\"rent_authorize\",\"rental_id\":\"R4\"}";
	char wrong_version[] = "{\"protocolVersion\":2,\"type\":\"rent_authorize\","
			       "\"rental_id\":\"R5\"}";
	char malformed[] = "{\"protocolVersion\":1,\"type\":\"rent_authorize\"";

	zassert_ok(bike_mqtt_parse_command(authorize, strlen(authorize), &msg));
	zassert_equal(msg.type, BIKE_BACKEND_RENT_AUTHORIZE);
	zassert_equal(strcmp(msg.rental_id, "R1"), 0);

	zassert_ok(bike_mqtt_parse_command(cancel, strlen(cancel), &msg));
	zassert_equal(msg.type, BIKE_BACKEND_RENT_CANCEL);
	zassert_equal(strcmp(msg.rental_id, "R2"), 0);

	zassert_equal(bike_mqtt_parse_command(unknown, strlen(unknown), &msg),
		      -ENOTSUP);
	zassert_equal(bike_mqtt_parse_command(missing_version,
					      strlen(missing_version), &msg),
		      -EPROTONOSUPPORT);
	zassert_equal(bike_mqtt_parse_command(wrong_version,
					      strlen(wrong_version), &msg),
		      -EPROTONOSUPPORT);
	zassert_true(bike_mqtt_parse_command(malformed, strlen(malformed),
					     &msg) < 0);
}

ZTEST(mqtt_client, test_command_parsing_bounds_rental_id)
{
	struct bike_backend_command_msg msg;
	char max_rental_id[BIKE_RENTAL_ID_MAX_LEN];
	char too_long_rental_id[BIKE_RENTAL_ID_MAX_LEN + 1];
	char max_payload[128];
	char too_long_payload[128];

	memset(max_rental_id, 'R', sizeof(max_rental_id) - 1);
	max_rental_id[sizeof(max_rental_id) - 1] = '\0';
	memset(too_long_rental_id, 'R', sizeof(too_long_rental_id) - 1);
	too_long_rental_id[sizeof(too_long_rental_id) - 1] = '\0';

	snprintf(max_payload, sizeof(max_payload),
		 "{\"protocolVersion\":1,\"type\":\"rent_authorize\","
		 "\"rental_id\":\"%s\"}",
		 max_rental_id);
	snprintf(too_long_payload, sizeof(too_long_payload),
		 "{\"protocolVersion\":1,\"type\":\"rent_authorize\","
		 "\"rental_id\":\"%s\"}",
		 too_long_rental_id);

	zassert_ok(bike_mqtt_parse_command(max_payload, strlen(max_payload),
					   &msg));
	zassert_equal(strcmp(msg.rental_id, max_rental_id), 0);
	zassert_equal(bike_mqtt_parse_command(too_long_payload,
					      strlen(too_long_payload), &msg),
		      -ENAMETOOLONG);
}

ZTEST(mqtt_client, test_command_handler_publishes_and_counts_errors)
{
	struct bike_backend_command_msg msg;
	struct bike_mqtt_status before;
	struct bike_mqtt_status after;
	char authorize[] = "{\"protocolVersion\":1,\"type\":\"rent_authorize\","
			   "\"rental_id\":\"R9\"}";
	char unknown[] = "{\"protocolVersion\":1,\"type\":\"bad\","
			 "\"rental_id\":\"R9\"}";

	zassert_ok(bike_config_init());
	zassert_ok(bike_config_set_id("BIKE_001"));
	zassert_ok(bike_config_set_device_token("TOKEN"));
	zassert_ok(bike_config_set_mqtt_host("broker.example.com"));
	zassert_ok(bike_config_set_mqtt_port(1883));
	zassert_ok(bike_config_set_apn("internet"));
	zassert_ok(bike_state_init());
	bike_mqtt_status_get(&before);
	zassert_ok(bike_mqtt_handle_command_payload(authorize,
						    strlen(authorize)));
	zassert_ok(zbus_chan_read(&backend_command_chan, &msg, K_MSEC(100)));
	zassert_equal(msg.type, BIKE_BACKEND_RENT_AUTHORIZE);
	zassert_equal(strcmp(msg.rental_id, "R9"), 0);
	zassert_ok(bike_state_cancel("R9"));

	zassert_equal(bike_mqtt_handle_command_payload(unknown,
						       strlen(unknown)),
		      -ENOTSUP);
	bike_mqtt_status_get(&after);
	zassert_equal(after.parse_error_count, before.parse_error_count + 1);
}

ZTEST(mqtt_client, test_telemetry_json_formatting)
{
	struct telemetry_sample_msg sample = {
		.bike_id = "BIKE_001",
		.state = BIKE_STATE_IN_USE,
		.rental_id = "R10",
		.uptime_ms = 12345,
		.speed_valid = true,
		.speed_milli_m_s = 2345,
		.gnss_fix_valid = true,
		.gnss_latitude_microdegrees = -3456789,
		.gnss_longitude_microdegrees = -38123456,
		.gnss_altitude_mm = 12345,
		.gnss_accuracy_mm = 6789,
		.motion_valid = true,
		.motion_moving = true,
		.motion_accel_milli_ms2 = { 100, 0, 9800 },
		.motion_gyro_milli_rad_s = { 0, 0, 10 },
		.motion_temp_milli_c = 31500,
	};
	char payload[640];

	zassert_true(bike_mqtt_format_telemetry_json(&sample, payload,
						     sizeof(payload)) > 0);
	zassert_equal(strcmp(payload,
			     "{\"protocolVersion\":1,\"bikeId\":\"BIKE_001\","
			     "\"status\":\"IN_USE\",\"uptimeMs\":12345,"
			     "\"rideId\":\"R10\",\"speedMetersPerSecond\":2.345,"
			     "\"gnss\":{\"valid\":true,\"latitude\":-3.456789,"
			     "\"longitude\":-38.123456,\"altitudeMeters\":12.345,"
			     "\"accuracyMeters\":6.789},\"motion\":{\"valid\":true,"
			     "\"moving\":true,\"accelMetersPerSecondSquared\":"
			     "{\"x\":0.100,\"y\":0.000,\"z\":9.800},"
			     "\"gyroRadiansPerSecond\":{\"x\":0.000,\"y\":0.000,"
			     "\"z\":0.010},\"temperatureCelsius\":31.500}}"), 0);
}

ZTEST(mqtt_client, test_telemetry_json_formats_invalid_optional_data)
{
	struct telemetry_sample_msg sample = {
		.bike_id = "BIKE_001",
		.state = BIKE_STATE_AVAILABLE,
		.uptime_ms = 12345,
	};
	char payload[192];

	zassert_true(bike_mqtt_format_telemetry_json(&sample, payload,
						     sizeof(payload)) > 0);
	zassert_equal(strcmp(payload,
			     "{\"protocolVersion\":1,\"bikeId\":\"BIKE_001\","
			     "\"status\":\"AVAILABLE\",\"uptimeMs\":12345,"
			     "\"rideId\":null,\"speedMetersPerSecond\":null,"
			     "\"gnss\":{\"valid\":false},"
			     "\"motion\":{\"valid\":false}}"), 0);
}

ZTEST(mqtt_client, test_event_json_formatting)
{
	struct bike_state_msg event_msg = {
		.state = BIKE_STATE_IN_USE,
		.event = BIKE_STATE_EVENT_RIDE_STARTED,
		.rental_id = "R10",
		.updated_at_ms = 5678,
	};
	char payload[192];

	zassert_ok(bike_config_init());
	zassert_ok(bike_config_set_id("BIKE_001"));

	zassert_true(bike_mqtt_format_state_event_json(&event_msg, payload,
						       sizeof(payload)) > 0);
	zassert_equal(strcmp(payload,
			     "{\"protocolVersion\":1,\"bikeId\":\"BIKE_001\","
			     "\"event\":\"ride_started\",\"status\":\"IN_USE\","
			     "\"rideId\":\"R10\",\"uptimeMs\":5678}"), 0);
}

ZTEST(mqtt_client, test_command_rejected_json_formatting)
{
	char payload[192];

	zassert_ok(bike_config_init());
	zassert_ok(bike_config_set_id("BIKE_001"));
	zassert_ok(bike_config_set_device_token("TOKEN"));
	zassert_ok(bike_config_set_mqtt_host("broker.example.com"));
	zassert_ok(bike_config_set_mqtt_port(1883));
	zassert_ok(bike_config_set_apn("internet"));
	zassert_ok(bike_state_init());
	zassert_ok(bike_state_authorize("ride-id"));
	zassert_ok(bike_state_button_press());

	zassert_true(bike_mqtt_format_command_rejected_json("rent_authorize",
							    "not_available",
							    payload,
							    sizeof(payload)) > 0);
	zassert_equal(strcmp(payload,
			     "{\"protocolVersion\":1,\"bikeId\":\"BIKE_001\","
			     "\"event\":\"command_rejected\",\"status\":\"IN_USE\","
			     "\"rideId\":\"ride-id\",\"command\":\"rent_authorize\","
			     "\"reason\":\"not_available\"}"), 0);
}

ZTEST(mqtt_client, test_command_rejected_json_formats_maximum_fields)
{
	char bike_id[BIKE_ID_MAX_LEN];
	char rental_id[BIKE_RENTAL_ID_MAX_LEN];
	char payload[256];

	memset(bike_id, 'B', sizeof(bike_id) - 1);
	bike_id[sizeof(bike_id) - 1] = '\0';
	memset(rental_id, 'R', sizeof(rental_id) - 1);
	rental_id[sizeof(rental_id) - 1] = '\0';

	zassert_ok(bike_config_init());
	zassert_ok(bike_config_set_id(bike_id));
	zassert_ok(bike_config_set_device_token("TOKEN"));
	zassert_ok(bike_config_set_mqtt_host("broker.example.com"));
	zassert_ok(bike_config_set_mqtt_port(1883));
	zassert_ok(bike_config_set_apn("internet"));
	zassert_ok(bike_state_init());
	zassert_ok(bike_state_authorize(rental_id));
	zassert_ok(bike_state_button_press());

	zassert_equal(bike_mqtt_format_command_rejected_json(
			      "rent_authorize", "no_active_reservation",
			      payload, 192),
		      -ENAMETOOLONG);
	zassert_true(bike_mqtt_format_command_rejected_json(
			     "rent_authorize", "no_active_reservation",
			     payload, sizeof(payload)) > 0);
}

ZTEST(mqtt_client, test_error_names)
{
	zassert_equal(strcmp(bike_mqtt_error_name(0), "none"), 0);
	zassert_equal(strcmp(bike_mqtt_error_name(-EINVAL),
			     "invalid_argument"), 0);
	zassert_equal(strcmp(bike_mqtt_error_name(-ECONNREFUSED),
			     "connection_refused"), 0);
	zassert_equal(strcmp(bike_mqtt_error_name(-12345), "errno"), 0);
}

ZTEST(telemetry, test_sample_includes_valid_gnss_fix)
{
	struct bike_gnss_fix fix = {
		.supported = true,
		.running = true,
		.valid = true,
		.uptime_ms = 1200,
		.latitude_microdegrees = -3456789,
		.longitude_microdegrees = -38123456,
		.altitude_mm = 12345,
		.accuracy_mm = 6789,
		.speed_milli_m_s = 2345,
	};
	struct motion_sensor_sample motion = {
		.valid = true,
		.moving = true,
		.accel_milli_ms2 = { 100, 0, 9800 },
		.gyro_milli_rad_s = { 0, 0, 10 },
		.die_temp_milli_c = 31500,
	};
	struct telemetry_sample_msg sample;

	bike_telemetry_fill_sample(&sample, "BIKE_TST", BIKE_STATE_IN_USE,
				   "RIDE_TST", 4567, &fix, &motion);

	zassert_equal(strcmp(sample.bike_id, "BIKE_TST"), 0);
	zassert_equal(sample.state, BIKE_STATE_IN_USE);
	zassert_equal(strcmp(sample.rental_id, "RIDE_TST"), 0);
	zassert_equal(sample.uptime_ms, 4567);
	zassert_true(sample.speed_valid);
	zassert_equal(sample.speed_milli_m_s, 2345);
	zassert_true(sample.gnss_fix_valid);
	zassert_equal(sample.gnss_latitude_microdegrees, -3456789);
	zassert_equal(sample.gnss_longitude_microdegrees, -38123456);
	zassert_equal(sample.gnss_altitude_mm, 12345);
	zassert_equal(sample.gnss_accuracy_mm, 6789);
	zassert_true(sample.motion_valid);
	zassert_true(sample.motion_moving);
	zassert_equal(sample.motion_accel_milli_ms2[0], 100);
	zassert_equal(sample.motion_gyro_milli_rad_s[2], 10);
	zassert_equal(sample.motion_temp_milli_c, 31500);
}

ZTEST(telemetry, test_sample_reports_no_fix_explicitly)
{
	struct bike_gnss_fix fix = {
		.supported = true,
		.running = true,
		.valid = false,
		.uptime_ms = 1200,
		.latitude_microdegrees = -3456789,
		.longitude_microdegrees = -38123456,
		.altitude_mm = 12345,
		.accuracy_mm = 6789,
	};
	struct telemetry_sample_msg sample;

	bike_telemetry_fill_sample(&sample, "BIKE_TST", BIKE_STATE_AVAILABLE,
				   NULL, 4567, &fix, NULL);

	zassert_equal(strcmp(sample.bike_id, "BIKE_TST"), 0);
	zassert_equal(sample.state, BIKE_STATE_AVAILABLE);
	zassert_equal(sample.uptime_ms, 4567);
	zassert_false(sample.speed_valid);
	zassert_false(sample.gnss_fix_valid);
	zassert_equal(sample.gnss_latitude_microdegrees, 0);
	zassert_equal(sample.gnss_longitude_microdegrees, 0);
	zassert_equal(sample.gnss_altitude_mm, 0);
	zassert_equal(sample.gnss_accuracy_mm, 0);
	zassert_false(sample.motion_valid);
}

ZTEST(telemetry, test_gnss_cache_retains_fresh_fix_over_no_fix)
{
	struct bike_gnss_fix valid_fix = {
		.supported = true,
		.running = true,
		.valid = true,
		.uptime_ms = k_uptime_get(),
		.latitude_microdegrees = 111,
		.longitude_microdegrees = 222,
		.altitude_mm = 333,
		.speed_milli_m_s = 444,
	};
	struct bike_gnss_fix no_fix = {
		.supported = true,
		.running = true,
		.valid = false,
		.uptime_ms = k_uptime_get(),
	};
	struct bike_gnss_fix latest;

	bike_gnss_init();
	bike_gnss_store_fix(&valid_fix);
	zassert_true(bike_gnss_get_latest(&latest));
	zassert_false(latest.retained);
	zassert_equal(latest.latitude_microdegrees, 111);
	zassert_equal(latest.speed_milli_m_s, 444);

	bike_gnss_store_fix(&no_fix);
	zassert_true(bike_gnss_get_latest(&latest));
	zassert_true(latest.valid);
	zassert_true(latest.retained);
	zassert_equal(latest.latitude_microdegrees, 111);
	zassert_equal(latest.speed_milli_m_s, 444);
}

ZTEST(telemetry, test_gnss_cache_expires_stale_fix)
{
	struct bike_gnss_fix stale_fix = {
		.supported = true,
		.running = true,
		.valid = true,
		.uptime_ms = k_uptime_get() -
			     (CONFIG_BIKE_GNSS_FIX_MAX_AGE_SECONDS + 1) *
				     MSEC_PER_SEC,
		.latitude_microdegrees = 111,
	};
	struct bike_gnss_fix no_fix = {
		.supported = true,
		.running = true,
		.valid = false,
		.uptime_ms = k_uptime_get(),
	};
	struct bike_gnss_fix latest;

	bike_gnss_init();
	bike_gnss_store_fix(&stale_fix);
	bike_gnss_store_fix(&no_fix);
	zassert_false(bike_gnss_get_latest(&latest));
	zassert_false(latest.valid);
	zassert_equal(latest.latitude_microdegrees, 0);
}

ZTEST_SUITE(bike_config, NULL, NULL, NULL, NULL, NULL);
ZTEST_SUITE(bike_state, NULL, NULL, NULL, NULL, NULL);
ZTEST_SUITE(led_status, NULL, NULL, NULL, NULL, NULL);
ZTEST_SUITE(button_input, NULL, NULL, NULL, NULL, NULL);
ZTEST_SUITE(mqtt_client, NULL, NULL, NULL, NULL, NULL);
ZTEST_SUITE(telemetry, NULL, NULL, NULL, NULL, NULL);
```
